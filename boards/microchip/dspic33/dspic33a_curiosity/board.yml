## boards/microchip/dspic33/dspic33a_curiosity/board.yml
```yaml
# SPDX-FileCopyrightText: Copyright (c) 2026 Microchip Technology Inc.
# SPDX-License-Identifier: Apache-2.0

board:
  name: dspic33a_curiosity
  full_name: dsPIC33A Curiosity Platform Development Board
  vendor: microchip
  socs:
    - name: p33ak128mc106
```

## drivers/timer/Kconfig.mchp
```kconfig
# SPDX-FileCopyrightText: Copyright (c) 2026 Microchip Technology Inc.
# SPDX-License-Identifier: Apache-2.0

config TIMER_MCHP_TIMER_G1
	bool "Microchip dsPIC33 G1 timer"
	default y
	depends on DT_HAS_MICROCHIP_TIMER_G1_TIMER_ENABLED
	help
	  This module implements a kernel device driver for group (g1) of
	  Microchip dsPIC33 timer peripherals and provides the standard
	  "system clock driver" interfaces.
```

## dts/bindings/cpu/microchip,dspic33a.yaml
```yaml
# SPDX-FileCopyrightText: Copyright (c) 2026 Microchip Technology Inc.
# SPDX-License-Identifier: Apache-2.0

description: Microchip dsPIC33A CPU

compatible: "microchip,dspic33a"

include: cpu.yaml
```

## dts/bindings/gpio/microchip,gpio-g1-gpio.yaml
```yaml
# SPDX-FileCopyrightText: Copyright (c) 2026 Microchip Technology Inc.
# SPDX-License-Identifier: Apache-2.0

title: Microchip dsPIC33 GPIO G1

description: |
  Microchip dsPIC33 GPIO port controller

  Group g1 GPIO driver supports following hardware peripherals:
    - module name="GPIO" id="04928" version="2"

compatible: "microchip,gpio-g1-gpio"

include: [gpio-controller.yaml]

properties:
  reg:
    type: array
    required: true

  gpio-controller: {}

  "#gpio-cells":
    type: int
    const: 2

gpio-cells:
  - pin
  - flags
```

## dts/bindings/pinctrl/microchip,gpio-g1-pinctrl.yaml
```yaml
# SPDX-FileCopyrightText: Copyright (c) 2026 Microchip Technology Inc.
# SPDX-License-Identifier: Apache-2.0

title: Microchip dsPIC33 Pinctrl G1

description: |
  Microchip dsPIC33 pin controller

  Group g1 PINCTRL driver supports following hardware peripherals:
    - module name="GPIO" id="04928" version="2"

compatible: "microchip,gpio-g1-pinctrl"

include: base.yaml

properties:
  reg:
    required: true

  "#address-cells":
    const: 1

  "#size-cells":
    const: 1

child-binding:
  description: Pin configuration node
  properties:
    pinmux:
      description: |
        Pin multiplexing configuration for this group.
        Multiple pins (like TX/RX) can be grouped inside one node.
      required: true
      type: int
```

## dts/bindings/timer/microchip,timer-g1-timer.yaml
```yaml
# SPDX-FileCopyrightText: Copyright (c) 2026 Microchip Technology Inc.
# SPDX-License-Identifier: Apache-2.0

title: Microchip dsPIC33 Timer G1

description: |
  Microchip DSPIC33 timer

  Group g1 TIMER driver supports following hardware peripherals:
    - module name="Timer" id="02673" version="1"

compatible: "microchip,timer-g1-timer"

include: base.yaml

properties:
  reg:
    required: true

  clock-frequency:
    type: int
    required: true
    description: |
      Input clock frequency, in Hz, feeding the timer's prescaler.

  prescaler:
    type: int
    required: true
    description: |
      Prescaler divider applied to clock-frequency before it reaches the
      timer's counter. Valid values are 1, 8, 64, and 256.

  interrupts:
    required: true

examples:
  - |
    timer1: timer@1e00 {
        compatible = "microchip,timer-g1-timer";
        reg = <0x1e00 0xc>;
        clock-frequency = <4000000>;
        prescaler = <8>;
        interrupt-parent = <&intc0>;
        interrupts = <48 1>;
        status = "disabled";
    };
```

## tests/drivers/uart/uart_async_api/boards/pic32cx_sg61_cult.conf
```kconfig
# SPDX-FileCopyrightText: Copyright (c) 2026 Microchip Technology Inc.
# SPDX-License-Identifier: Apache-2.0

CONFIG_UART_ASYNC_API=y
CONFIG_DMA=y
```
